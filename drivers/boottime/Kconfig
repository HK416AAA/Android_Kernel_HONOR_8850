## drivers/boottime/Kconfig
```kconfig
config HONOR_BOOT_TIME
	tristate "Boot Time Recoder"
	default n
	help
	  A driver to record boot time, used
	  to identify which components take the
	  most time during startup, allowing for
	  improvements to reduce boot-up time.
```
